## app/example/Config.in
```kconfig
# --- Generated Automatically ---
config AOS_APP_EXAMPLE
    bool "Builtin Examples"

if AOS_APP_EXAMPLE
choice
    prompt "Select example"

source "app/example/uart/Config.in"
if AOS_APP_UART
    config AOS_BUILD_APP
        default "uart"
endif

source "app/example/mqttapp/Config.in"
if AOS_APP_MQTTAPP
    config AOS_BUILD_APP
        default "mqttapp"
endif

endchoice
endif
# --- End ---
```

## board/Config.in
```kconfig
# --- Generated Automatically ---
menu "BSP         Configuration"
choice
    prompt "Select board"

source "board/linuxhost/Config.in"
if AOS_BOARD_LINUXHOST
    config AOS_BUILD_BOARD
        default "linuxhost"

    source "platform/mcu/linux/Config.in"
    source "platform/arch/linux/Config.in"
endif

source "board/mk3060/Config.in"
if AOS_BOARD_MK3060
    config AOS_BUILD_BOARD
        default "mk3060"

    source "platform/mcu/moc108/Config.in"
    source "platform/arch/arm/armv5/Config.in"
endif

endchoice

endmenu
# --- End ---
```

## network/Config.in
```kconfig
menu "Network     Configuration"

source "network/lwip/Config.in"
source "network/nal/sal/Config.in"
source "network/netmgr/Config.in"
source "network/yloop/Config.in"
source "network/http/Config.in"
source "network/und/Config.in"

endmenu
```
